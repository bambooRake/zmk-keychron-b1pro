## app/dts/bindings/behaviors/zmk,behavior-mouse-key-press.yaml
```yaml
# Copyright (c) 2024 The ZMK Contributors
# SPDX-License-Identifier: MIT

description: Mouse button press/release behavior

compatible: "zmk,behavior-mouse-key-press"

include: one_param.yaml
```

## app/dts/bindings/behaviors/zmk,behavior-mouse-scroll.yaml
```yaml
# Copyright (c) 2024 The ZMK Contributors
# SPDX-License-Identifier: MIT

description: Mouse scroll behavior

compatible: "zmk,behavior-mouse-scroll"

include: one_param.yaml
```
